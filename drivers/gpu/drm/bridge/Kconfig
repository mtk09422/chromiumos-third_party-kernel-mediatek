## drivers/gpu/drm/bridge/Kconfig
```kconfig
config DRM_PTN3460
	tristate "PTN3460 DP/LVDS bridge"
	depends on DRM
	select DRM_KMS_HELPER
	---help---

config DRM_IT6151
	bool "Enable IT6151FN : MIPI to eDP Converter"
	depends on DRM
	select DRM_KMS_HELPER
	help
	  Choose this option if you have IT6151 for display
	  The IT6151 is a high-performance and low-power
	  MIPI to eDP converter
```

## drivers/gpu/drm/img-rogue/Kconfig
```kconfig
config DRM_POWERVR_ROGUE
	tristate "PowerVR Rogue"
	depends on HAS_IOMEM
	depends on DRM
	select DRM_KMS_HELPER
	help
	  Driver for PowerVR Rogue graphics hardware.

	  Say Y here if your SoC contains a PowerVR Rogue GPU. For more
	  information, see <http://www.imgtec.com/powervr/>.

config DRM_POWERVR_ROGUE_DEBUG
	bool "Enable PowerVR Rogue debug features"
	depends on POWERVR_ROGUE
	default n
	help
	  Add additional debug features to the PowerVR Rogue driver.
```

## drivers/gpu/drm/mediatek/Kconfig
```kconfig
config DRM_MEDIATEK_ROGUE
	tristate "DRM Support for Mediatek KMS and PVR ROGUE GPU"
	depends on DRM
	depends on MTK_IOMMU
	depends on ARCH_MEDIATEK || (ARM && COMPILE_TEST)
	select DRM_PANEL
	select DRM_MIPI_DSI
	select DRM_PANEL_SIMPLE
	select DRM_KMS_HELPER
	select POWERVR_ROGUE
	help
	  Choose this option if you have a Mediatek SoCs with PVR Rogue.
	  The module will be called by pvr drm module
	  This driver provides kernel mode setting and
	  buffer management to userspace.

config DRM_MEDIATEK
	tristate "DRM Support for Mediatek SoCs"
	depends on DRM
	depends on MTK_IOMMU
	depends on ARCH_MEDIATEK || (ARM && COMPILE_TEST)
	depends on !DRM_MEDIATEK_ROGUE
	select DRM_PANEL
	select DRM_MIPI_DSI
	select DRM_PANEL_SIMPLE
	select DRM_KMS_HELPER
	help
	  Choose this option if you have a Mediatek SoCs.
	  The module will be called mediatek-drm
	  This driver provides kernel mode setting and
	  buffer management to userspace.

config DRM_MEDIATEK_FBDEV
	bool "Enable legacy fbdev support for Mediatek DRM"
	depends on DRM_MEDIATEK || DRM_MEDIATEK_ROGUE
	select FB_SYS_FILLRECT
	select FB_SYS_COPYAREA
	select FB_SYS_IMAGEBLIT
	select DRM_KMS_FB_HELPER
	help
	  Choose this option if you have a need for the legacy
	  fbdev support.  Note that this support also provides
	  the Linux console on top of the Mediatek DRM mode
	  setting driver.

config DRM_MEDIATEK_IT6151
	bool "Enable IT6151FN : MIPI to eDP Converter"
	depends on DRM_MEDIATEK || DRM_MEDIATEK_ROGUE
	help
	  Choose this option if you have IT6151 for display
	  The IT6151 is a high-performance and low-power
	  MIPI to eDP converter
	  This driver is used for test

config DRM_MEDIATEK_HDMI
	tristate "DRM HDMI Support for Mediatek SoCs"
	depends on DRM_MEDIATEK || DRM_MEDIATEK_ROGUE
	default y
	help
	  DRM/KMS HDMI driver for Mediatek SoCs
```

## drivers/pinctrl/mediatek/Kconfig
```kconfig
if ARCH_MEDIATEK

config PINCTRL_MTK_COMMON
	bool
	select PINMUX
	select GENERIC_PINCONF

config PINCTRL_MT8135
	def_bool MACH_MT8135
	select PINCTRL_MTK_COMMON

config PINCTRL_MT6397
	def_bool MACH_MT8135 || MACH_MT8173

endif
```

## drivers/soc/Kconfig
```kconfig
menu "SOC (System On Chip) specific Drivers"

source "drivers/soc/qcom/Kconfig"
source "drivers/soc/mediatek/Kconfig"

endmenu
```

## drivers/soc/mediatek/Kconfig
```kconfig
#
# MediaTek SoC drivers
#
config MTK_PMIC_WRAP
	tristate "MediaTek PMIC Wrapper Support"
	depends on ARCH_MEDIATEK
	select REGMAP
	help
	  Say yes here to add support for MediaTek PMIC Wrapper found
	  on the MT8135 and MT8173 SoCs. The PMIC wrapper is a proprietary
	  hardware to connect the PMIC.

config MTK_SCPSYS
	tristate "MediaTek SCPSYS Support"
	help
	  Say yes here to add support for the MediaTek SCPSYS power domain
	  driver.

config MTK_SMI
        bool
	help
	  Smi help enable/disable iommu in mt8173 and control the
	  clock of each local arbiter.
	  It should be true while MTK_IOMMU enable.
```

## drivers/staging/img-rogue/Kconfig
```kconfig
########################################################################### ###
#@Copyright     Copyright (c) Imagination Technologies Ltd. All Rights Reserved
#@License       Strictly Confidential.
### ###########################################################################

config POWERVR_ROGUE
	tristate "PowerVR Rogue"
	depends on HAS_IOMEM
	depends on DRM
	select DRM_KMS_HELPER
	select POWERVR_DRMPDP
	help
	  Driver for PowerVR Rogue graphics hardware.

	  Say Y here if your SoC contains a PowerVR Rogue GPU. For more
	  information, see <http://www.imgtec.com/powervr/>.

config POWERVR_ROGUE_XT
	bool "Enable PowerVR Rogue for mediatek 8173"
	depends on POWERVR_ROGUE
	default n
	help
	  By default, the driver is built for the MT8135.
	  Choose this option if you are building for the MT8173.
```

## drivers/staging/mediatek/Kconfig
```kconfig
config DRM_MEDIATEK
	tristate "DRM Support for Mediatek SoCs"
	depends on DRM
	depends on ARCH_MEDIATEK || (ARM && COMPILE_TEST)
	depends on !DRM_MEDIATEK_ROGUE
	select DRM_PANEL
	select DRM_MIPI_DSI
	select DRM_PANEL_SIMPLE
	select DRM_KMS_HELPER
	help
	  Choose this option if you have a Mediatek SoCs.
	  The module will be called mediatek-drm
	  This driver provides kernel mode setting and
	  buffer management to userspace.

config DRM_MEDIATEK_FBDEV
	bool "Enable legacy fbdev support for Mediatek DRM"
	depends on DRM_MEDIATEK || DRM_MEDIATEK_ROGUE
	select FB_SYS_FILLRECT
	select FB_SYS_COPYAREA
	select FB_SYS_IMAGEBLIT
	select DRM_KMS_FB_HELPER
	help
	  Choose this option if you have a need for the legacy
	  fbdev support.  Note that this support also provides
	  the Linux console on top of the Mediatek DRM mode
	  setting driver.
```

## sound/soc/mediatek/Kconfig
```kconfig
config SND_SOC_MT8173
	bool

config SND_SOC_MT8173_MT6397
	bool "ASoC Audio driver for MT8173 with MT6397 codec"
	depends on ARCH_MEDIATEK
	select SND_SOC_MT8173
	select SND_SOC_MT6397
	help
	  This adds ASoC driver for Mediatek MT8173 boards
	  with the MT6397 audio codec.
	  Select Y if you have such device.
	  Ex: mt8173_evb

config SND_SOC_MT8173_MAX98090
	bool "ASoC Audio driver for MT8173 with MAX98090 codec"
	depends on ARCH_MEDIATEK
	select SND_SOC_MT8173
	select SND_SOC_MAX98090
	help
	  This adds ASoC driver for Mediatek MT8173 boards
	  with the MAX98090 audio codec.
	  Select Y if you have such device.
	  If unsure select "N".
```
