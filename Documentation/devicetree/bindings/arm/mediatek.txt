## Documentation/devicetree/bindings/reset/mediatek,reset.txt
```
MediaTek SoC Reset Controller
======================================
The reset controller driver accesses registers through the syscon regmap. It
is a child node of syscon.

Required properties:
- compatible : "mediatek,reset"
- #reset-cells: 1
- reg: The register region can be accessed from syscon. The first parameter is
  reset base address offset. The second parameter is byte width of reset registers.

example:
infracfg: syscon@10001000 {
	#address-cells = <1>;
	#size-cells = <1>;
	compatible = "mediatek,mt8135-infracfg", "syscon";
	reg = <0 0x10001000 0 0x1000>;

	infrarst: reset-controller@30 {
		#reset-cells = <1>;
		compatible = "mediatek,mt8135-infracfg-reset", "mediatek,reset";
		reg = <0x30 0x8>;
	};
};

Specifying reset lines connected to IP modules
==============================================

The reset controller(mtk-reset) manages various reset sources. Those device nodes should
specify the reset line on the rstc in their resets property, containing a phandle to the
rstc device node and a RESET_INDEX specifying which module to reset, as described in
reset.txt.

For MediaTek SoC, RESET_INDEX is reset bit defined in INFRACFG or PERICFG registers.

example:
pwrap: pwrap@1000f000 {
	compatible = "mediatek,mt8135-pwrap";
	reg = <0 0x1000f000 0 0x1000>,
		<0 0x11017000 0 0x1000>;
	reg-names = "pwrap-base",
		"pwrap-bridge-base";
	resets = <&infrarst MT8135_INFRA_PMIC_WRAP_RST>,
		<&perirst MT8135_PERI_PWRAP_BRIDGE_SW_RST>;
	reset-names = "infrarst", "perirst";
};

Definitions for the supported resets by IC:
MT8135:
include/dt-bindings/reset-controller/mt8135-resets.h
MT8173:
include/dt-bindings/reset-controller/mt8173-resets.h
```

## Documentation/devicetree/bindings/rtc/mediatek,mt63xx-rtc.txt
```
Mediatek MT63xx real-time clock

MT63xx is Mediatek PMIC chip series. RTC is one submodule of PMIC chip.
The RTC maintains seconds counter, also provide alarm function.

Required properties:
- compatible: Should be "mediatek,mt6397-rtc".
- reg: base physical address and size of the registers.
- interrupt-parent: phandle for the interrupt controller
- interrupts: RTC alarm interrupt.

Examples:
rtc: rtc@e000 {
	compatible = "mediatek,mt6397-rtc";
	reg = <0xe000 0x3e>;
	interrupt-parent = <&pmic>;
	interrupts = <20 IRQ_TYPE_LEVEL_HIGH>;
};
```

## Documentation/devicetree/bindings/soc/mediatek/mediatek,mt8135-pwrap.txt
```
MediaTek MT8135 PMIC Wrapper Driver

MediaTek PMIC MFD is interfaced to host controller using SPI interface
by a proprietary hardware called PMIC wrapper or pwrap.

+-----------------+           +---------------+
|                 |           |               |
| Mediatek AP SoC |           |               |
| (ex. MT8135)    |           |    MT6397     |
|                 |           |               |
|      +--------+ | (SPI bus) | +--------+    |
|      |        | |-----------| |        |    |
|      |  PMIC  | |-----------| |  PMIC  |    |
|      | Wrapper| |-----------| | Wrapper|    |
|      |        | |-----------| |        |    |
|      +--------+ |           | +--------+    |
|                 |           |               |
+-----------------+           +---------------+

This document describes the binding for MT8135 PMIC wrapper.

Required properties in pwrap device node.
- compatible:"mediatek,mt8135-pwrap"
- interrupts: IRQ for pwrap in SOC
- reg: address range for pwrap registers
- resets: reset bit for pwrap
- clock: clock frequency selection in SPI bus

Optional properities:
- pmic: Mediatek PMIC MFD is the child device of pwrap
  See the following for child node definitions:
  Documentation/devicetree/bindings/mfd/mt6397.txt

Example:
	pwrap: pwrap@1000f000 {
		compatible = "mediatek,mt8135-pwrap";
		reg = <0 0x1000f000 0 0x1000>,
			<0 0x11017000 0 0x1000>;
		reg-names = "pwrap-base", "pwrap-bridge-base";
		interrupts = <GIC_SPI 128 IRQ_TYPE_LEVEL_HIGH>;
		resets = <&infrarst MT8135_INFRA_PMIC_WRAP_RST>,
				<&perirst MT8135_PERI_PWRAP_BRIDGE_SW_RST>;
		reset-names = "infra-pwrap-rst",
				"peri-pwrap-bridge-rst";
		clocks = <&pmicspi_sel>, <&clk26m>;
		clock-names = "pmicspi-sel", "pmicspi-parent";

		pmic {
			compatible = "mediatek,mt6397";
		};
	};
```

## Documentation/devicetree/bindings/soc/mediatek/mediatek,smi.txt
```
SMI hardware block diagram please help check <bindings/iommu/mediatek,iommu.txt>

Required properties:
- compatible : must be "mediatek,mediatek,mt8173-smi-larb"
- reg : the register of each local arbiter
- clocks : the clocks of each local arbiter
- clock-name: larb_sub*(3 clockes at most)

Example:
	larb1:larb@16010000 {
	        compatible = "mediatek,mt8173-smi-larb";
		reg = <0 0x16010000 0 0x1000>;
		clocks = <&mmsys MM_SMI_COMMON>,
		        <&vdecsys VDEC_CKEN>,
                        <&vdecsys VDEC_LARB_CKEN>;
		clock-names = "larb_sub0", "larb_sub1", "larb_sub2";
	};
```

## Documentation/devicetree/bindings/sound/mediatek,mt-soc-pcm-dl1.txt
```
Mediatek DL1 PCM controller

Required properties:
- compatible = "mediatek,mt-soc-dl1-pcm";
- reg :
	- first element: DL1 SRAM location and length
	- second element: registers location and length
- interrupts : Should contain PCM interrupt

Example:

	mt-soc-dl1-pcm {
		compatible = "mediatek,mt-soc-dl1-pcm";
		reg = <0 0x12008000 0 0x4000>,
		      <0 0x12070000 0 0x10000>;
		interrupts = <GIC_SPI 104 IRQ_TYPE_LEVEL_LOW>;
	};
```

## Documentation/devicetree/bindings/sound/mediatek,mt8135-evbp1.txt
```
Mediatek MT8135 evbp1 audio setups

Required properties:
- compatible = "mediatek,mt8135-evbp1";
- clock-names : Must include the following entries:
  - infra_audio_clk
  - afe_clk
- mediatek,audio-codec: The phandle of the MT6397 audio codec.

Example:

	sound {
		compatible = "mediatek,mt8135-evbp1";
		clocks = <&audio_ck>,
			<&afe_ck>;
		clock-names =   "infra_audio_clk",
				"afe_clk";
		mediatek,audio-codec = <&mt6397codec>;
	};
```

## Documentation/devicetree/bindings/sound/mtk-afe-pcm.txt
```
Mediatek AFE PCM controller

The AFE unit can be illustrated by this figure:

| MEMIF    |      AFE      |     IO     |
           *****************
DL1------> *I5           O3* <----I2S--->
           *I6           O4*
           *             I3*
           *             I4*
           *             O0* <--2ndI2S-->
           *             O1*
           *             I0*
           *             I1*
AWB<------ *O5             * <--MTKIF--->
           *O6             *
VUL<------ *O9             * <---HDMI--->
           *O10            *
           *      AFE      *
HDMI-----> * inter-connect *
           *****************
AFE comprises several memory interfaces (DL1, DL2, VUL, DAI, AWB, MOD_DAI
and HDMI) that communicate with CPU, a multi input multi output digital audio
interconnect, and several external interfaces (I2S, proprietary MTKIF, HDMI).
Each external interface (called "IO" in this driver) is presented as a
DAI to ASoC. An IO must be connected via the interconnect to a memif.
The connection paths are configured through the device tree.

Required properties:
- compatible = "mediatek,mt8173-afe-pcm";
- reg: array of register and sram location and size:
       <register base address, size>,
       <sram base address, size>;
- interrupts: Should contain AFE interrupt
- clock-names: should have these clock names:
		"infra_sys_audio_clk",
		"top_pdn_audio",
		"top_pdn_aud_intbus",
		"bck0",
		"bck1",
		"i2s0_m",
		"i2s1_m",
		"i2s2_m",
		"i2s3_m",
		"i2s3_b";

DAI subnodes:
  A DAI subnode describes which io connects to which memif.

Required subnode properties:
- io: which I/O to be used
      (defined in include/dt-bindings/sound/mtk-afe.h)
- connections: AFE connection pairs definition of this dai
	       For example, <5 3 6 4> means I5->O3, I6->O4
	       check SoC datasheet for a complete description
- mem-interface-playback:
  mem-interface-capture: property of memif, format is: <memif irq use_sram>;
	                 memif: which memif to be used
			        (defined in include/dt-bindings/sound/mtk-afe.h)
		         irq: which irq to be used
			      (defined in include/dt-bindings/sound/mtk-afe.h)
		         use_sram: 1 is yes, 0 is no

  Each DAI should describes at least playback or capture

Example:

	afe: mt8173-afe-pcm@11220000  {
		compatible = "mediatek,mt8173-afe-pcm";
		reg = <0 0x11220000 0 0x1000>,
		      <0 0x11221000 0 0x9000>;
		interrupts = <GIC_SPI 134 IRQ_TYPE_EDGE_FALLING>;
		clocks = <&infracfg INFRA_AUDIO>,
			<&topckgen TOP_AUDIO_SEL>,
			<&topckgen TOP_AUD_INTBUS_SEL>,
			<&topckgen TOP_APLL1_DIV0>,
			<&topckgen TOP_APLL2_DIV0>,
			<&topckgen TOP_I2S0_M_CK_SEL>,
			<&topckgen TOP_I2S1_M_CK_SEL>,
			<&topckgen TOP_I2S2_M_CK_SEL>,
			<&topckgen TOP_I2S3_M_CK_SEL>,
			<&topckgen TOP_I2S3_B_CK_SEL>;
		clock-names = "infra_sys_audio_clk",
				"top_pdn_audio",
				"top_pdn_aud_intbus",
				"bck0",
				"bck1",
				"i2s0_m",
				"i2s1_m",
				"i2s2_m",
				"i2s3_m",
				"i2s3_b";
		dai@0 {
			io = <MTK_AFE_IO_I2S>;
			connections = <5 3 6 4 3 9 4 10>;
			mem-interface-playback = <MTK_AFE_MEMIF_DL1 MTK_AFE_IRQ_1 1>;
			mem-interface-capture = <MTK_AFE_MEMIF_VUL MTK_AFE_IRQ_2 0>;
		};

		dai@1 {
			io = <MTK_AFE_IO_HDMI>;
			connections = <36 36 37 37 34 32 35 33 32 34 33 35 30 30 31 31>;
			mem-interface-playback = <MTK_AFE_MEMIF_HDMI MTK_AFE_IRQ_5 0>;
		};
	};
```

## Documentation/devicetree/bindings/spi/spi-mt6577.txt
```
* Mediatek's SPI controller

The Mediatek's SPI controller is used to interface with SPI devices.

Required properties:
  - compatible: value should be either of the following.
      (a) "mediatek,mt6577-spi", for spi compatible with mt6577 spi.
      (b) "mediatek,mt6589-spi", for spi compatible with mt6589 spi.
      (c) "mediatek,mt8127-spi", for spi compatible with mt8127 spi.
      (d) "mediatek,mt8135-spi", for spi compatible with mt8135 spi.
  - reg: physical base address of the controller and dma base, length of memory mapped
    region.
  - interrupts: interrupt number to the cpu.
  - cell-index: the index of the spi controller.
  - clocks: clock name from clock manager.

Optional properties:
  - spi-max-frequency: Definition as per
                     Documentation/devicetree/bindings/spi/spi-bus.txt

Example:

    spi@11016000 {
      compatible = "mediatek,mt6577-spi";
      reg = <0 0x11016000 0 0x1000>;
      interrupts = <GIC_SPI 78 IRQ_TYPE_LEVEL_LOW>;
      cell-index = <0>;
      clocks = <&pericfg PERI_SPI1_CK>;
      clock-names = "peri_spi";
      #address-cells = <1>;
      #size-cells = <0>;
    };
```

## Documentation/devicetree/bindings/usb/mt65xx-u3phy.txt
```
MT65xx U3PHY

The device node for Mediatek SOC usb3.0 phy

Required properties:
 - compatible : Should be "mediatek,mt8173-u3phy"
 - reg        : Offset and length of registers
 - usb-host   : usb controller which the phy will bind
 - reg-vusb33-supply:  regulator of usb avdd3.3v
 - clocks     : must support all clocks that phy need
 - clock-names: the names of clocks
 - p1-gpio    : must contain gpio controller, gpio number and valid level
 - pinctrl-names &pinctrl-0    : maybe not neccesary, is only used to set
   gpio-pin mode

Example:

u3phy: usb-phy@11271000 {
	compatible = "mediatek,mt8173-u3phy";
	reg = <0 0x11271000 0 0x3000>,
		<0 0x11280000 0 0x20000>;
	usb-host = <&usb>;
	reg-vusb33-supply = <&mt6397_usb_reg>;
	usb3_ref_clk = <&apmixedsys>;
	clocks = <&scpsys SCP_SYS_USB>,
		<&perisys PERI_USB0>,
		<&perisys PERI_USB1>;
	clock-names = "scp_sys_usb", "peri_usb0", "peri_usb1";
	p1-gpio = <&pio 130 0>; /* 0: high level valid */
};
```

## Documentation/devicetree/bindings/usb/mt65xx-usb.txt
```
MT65XX MUSB

Required properties:
 - compatible : Should be "stericsson,db8500-musb"
 - reg        : Offset and length of registers
 - interrupts : Interrupt; mode, number and trigger
 - mode    : Dual-role; either host mode "0", peripheral mode "1"
                or both otg mode "2"

Example:

USB0@0x11200000 {
	compatible = "mediatek,mt6577-usb0";
	cell-index = <0>;
	reg = <0 0x11200000 0 0x10000>,
		<0 0x11220000 0 0x10000>;
	interrupts = <GIC_SPI 64 IRQ_TYPE_LEVEL_LOW>;
	mode = <2>;
	multipoint = <1>;
	num_eps = <16>;
	clocks =<&usb0_ck>, <&univpll>;
	clock-names = "usb0_clk_main", "univpll_clk";
};
```

## Documentation/devicetree/bindings/usb/mt8173-xhci.txt
```
MT65XX xhci

The device node for Mediatek SOC usb3.0 host controller

Required properties:
 - compatible : Should follow xhci dts binding file requirement
 - reg        : Offset and length of registers
 - interrupts : Interrupt; mode, number and trigger
 - mediatek,phy : the phy that xhci will bind

Example:
usb: usb30@11270000 {
	compatible = "mediatek,mt8173-xhci", "generic-xhci";
	reg = <0 0x11270000 0 0x1000>;
	interrupts = <0 115 0x8>;
	mediatek,phy = <&u3phy>;
};

u3phy:usb-phy@11271000 {
	compatible = "mediatek,mt65xx-u3phy";
	reg = <0 0x11271000 0 0x3000>,
		<0 0x11280000 0 0x20000>;
	usb-host = <&usb>;
	...
};
```

## Documentation/devicetree/bindings/watchdog/mt65xx_wdt.txt
```
Mediatek MT65XX Watchdog Timer (WDT) Controller

Required properties:
compatible:
- "mediatek,mt6577-watchdog" for mt6577

Examples:

watchdog: watchdog@10000000 {
	compatible = "mediatek,mt6577-watchdog";
	reg = <0 0x10000000 0 0x100>;
};
```
