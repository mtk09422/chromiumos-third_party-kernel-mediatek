## Documentation/devicetree/bindings/arm/mediatek.txt
```
Mediatek Mobile Platforms Device Tree Bindings

Boards with a Mediatek Mobile SoC shall have the following property:

Required root node property:

compatible: must be one of
	"mediatek,mt6589",
	"mediatek,mt8127",
	"mediatek,mt8135"
```

## Documentation/devicetree/bindings/clock/mediatek,mt6397-clock.txt
```
Binding for MT6397 clock driver

MT6397 clock is a sub-module of MT6397 multi-function device.
It contains clocks to support internal functions, such as i2c, audio, etc. It is
controlled over pmic wrapper.
More information of MT6397 MFD can be found in bindings/mfd/mt6397.txt file.

Following properties should be presend in main device node of the MFD chip.

Required properties:
- compatible: "mediatek,mt6397-clk"
- #clock-cells: it shall be set to 1.

Clocks are defined in dt-bindings/clock/mediatek,mt6397-clks.h
header and can be used in device tree sources.

Example: clock node of the MFD chip
	pmic {
		compatible = "mediatek,mt6397";

		mt6397clock: mt6397clock {
			compatible = "mediatek,mt6397-clk";
			#clock-cells = <1>;
		};
	};

Example: clock consumer node
	i2c4: i2c@11011000 {
		compatible = "mediatek,mt8135-i2c";
		mediatek,have-pmic;
		clocks = <&mt6397clock MT6397_WRPCKPDN_I2C0>;
		clock-names = "pmic";
	};
```

## Documentation/devicetree/bindings/clock/mediatek,mt8135-clock.txt
```
Mediatek MT8135 Clock Controller

This binding uses the common clock binding:
Documentation/devicetree/bindings/clock/clock-bindings.txt

The Mediatek MT8135 clock controller generates and supplies clock to various
controllers within Mediatek MT8135 SoC.

Required Properties:

- compatible: should be one of following:
	- "mediatek,mt8135-topckgen" : for topckgen clock controller of MT8135.
	- "mediatek,mt8135-apmixedsys" : for apmixed_sys (PLLs) of MT8135.
	- "mediatek,mt8135-infracfg" : for infra_sys clock controller of MT8135.
	- "mediatek,mt8135-pericfg" : for peri_sys clock controller of MT8135.

- reg: physical base address of the controller and length of memory mapped
  region.

- #clock-cells: should be 1.

All available clocks are defined as preprocessor macros in
dt-bindings/clock/mt8135-clk.h header and can be used in device tree sources.

Example: I2C controller node that consumes the clock generated by the clock
  controller (refer to the standard clock bindings for information about
  "clocks" and "clock-names" properties):

	i2c0: i2c@1100d000 {
		compatible = "mediatek,mt8135-i2c", "mediatek,mt6589-i2c";
		reg = <0 0x1100d000 0 0x70>, <0 0x11000300 0 0x80>;
		interrupts = <GIC_SPI 44 IRQ_TYPE_LEVEL_LOW>;
		clock-div = <16>;
		clocks = <&pericfg PERI_I2C0_CK>, <&pericfg PERI_AP_DMA_CK>;
		clock-names = "main", "dma";
	};
```

## Documentation/devicetree/bindings/clock/mediatek-clocks.txt
```
Mediatek MT8135 Clock Controller

This binding uses the common clock binding:
Documentation/devicetree/bindings/clock/clock-bindings.txt

The Mediatek MT8135 clock controller generates and supplies clock to various
controllers within Mediatek MT8135 SoC.


Root clock:

Required properties:
- compatible : shall be:
  "mediatek,clk-fixed_rate" - root clock with fixed rate.
- #clock-cells : from common clock binding; shall be set to 0.
- clock-frequency : frequency of clock in Hz. Should be a single cell.

Example:

	clk26m: clk26m {
		compatible = "mediatek,clk-fixed_rate";
		#clock-cells = <0>;
		clock-frequency = <26000000>;
	};


PLL:

Required properties:
- compatible : shall be one of:
  "mediatek,clk-pll-arm" - armpll on MT8135.
  "mediatek,clk-pll-main" - mainpll on MT8135.
  "mediatek,clk-pll-univ" - univpll on MT8135.
  "mediatek,clk-pll-mm" - mmpll on MT8135.
  "mediatek,clk-pll-msdc" - msdcpll on MT8135.
  "mediatek,clk-pll-tvd" - tvdpll on MT8135.
  "mediatek,clk-pll-lvds" - lvdspll on MT8135.
  "mediatek,clk-pll-aud" - audpll on MT8135.
  "mediatek,clk-pll-vdec" - vdecpll on MT8135.
- #clock-cells : from common clock binding; shall be set to 0.
- reg : address and length of the register set for controlling the clock.
- clocks : link to phandle of parent clocks.

Example:

	mainpll: mainpll@1020921c {
		compatible = "mediatek,clk-pll-main";
		#clock-cells = <0>;
		reg = <0 0x1020921c 0 0x4>, <0 0x10209234 0 0x4>;
		clocks = <&clk26m>;
	};


Divider:

Required properties :
- compatible : shall be:
  "mediatek,clk-fixed_factor" - divider with fixed factor.
- #clock-cells : from common clock binding; shall be set to 0.
- clocks : link to phandle of parent clocks.
- clock-mult : fixed multiplier.
- clock-div : fixed divider.

Example:

	mainpll_806m: mainpll_806m {
		compatible = "mediatek,clk-fixed_factor";
		#clock-cells = <0>;
		clocks = <&mainpll>;
		clock-mult = <1>;
		clock-div = <2>;
	};


Multiplexer:

Required properties :
- compatible : shall be:
  "mediatek,clk-mux" - multiplexer with optional gate.
- reg : address and length of the register set for controlling the clock.
- #clock-cells : from common clock binding; shall be set to 0.
- clocks : link to phandle of parent clocks.
- bit-shift : number of bits to shift the bit-mask.
- bit-width : number of bits of the bit-mask.

Optional properties:
- gate-bit : bit to gate the MUX, unable to gate if not present.

Example:

	top0: clk@10000140 {
		compatible = "mediatek,clk-mux";
		reg = <0 0x10000140 0 0x4>;

		top0_clocks: clocks {
			axi_sel: axi_sel {
				#clock-cells = <0>;
				clocks = <&clk26m>, <&syspll_d3>;
				bit-shift = <0>;
				bit-width = <3>;
			};

			irda_sel: irda_sel {
				#clock-cells = <0>;
				clocks = <&clk26m>, <&univpll2_d8>, <&univpll1_d6>;
				bit-shift = <24>;
				bit-width = <2>;
				gate-bit = <31>;
			};
		};
	};


Clock gate:

Required properties :
- compatible : shall be one of:
  "mediatek,clk-gate" - clock gate with state / clear / set registers.
  "mediatek,clk-gate-inv" - clock gate with inversed setting: 1 for enable,
			    0 for disable.
- reg : address and length of the register set for controlling the clock.
	shall be 3 cells to present state / clear / set registers.
- #clock-cells : from common clock binding; shall be set to 0.
- clocks : link to phandle of parent clocks.
- bit-shift : bit shift for programming the clock gate.

Example:

	cg_infra: clk@10001040 {
		compatible = "mediatek,clk-gate";
		reg = <0 0x10001048 0 0x4>, <0 0x10001044 0 0x4>, <0 0x10001040 0 0x4>;

		cg_infra_clocks: clocks {
			audio_ck: audio_ck {
				#clock-cells = <0>;
				clocks = <&aud_intbus_sel>;
				bit-shift = <5>;
			};

			smi_ck: smi_ck {
				#clock-cells = <0>;
				clocks = <&smi_sel>;
				bit-shift = <1>;
			};
		};
	};


Audio clock gate:

Required properties :
- compatible : shall be:
  "mediatek,clk-gate-audio" - clock gate with 2 parents.
- #clock-cells : from common clock binding; shall be set to 0.
- reg : address and length of the register set for controlling the clock.
- clocks : link to phandle of parent clocks, shall be 2 cells.
- bit-shift : bit shift for programming the clock gate.

Example:

	cg_audio: clk@12070000 {
		compatible = "mediatek,clk-gate-audio";
		reg = <0 0x12070000 0 0x4>;

		cg_audio_clocks: clocks {
			afe_ck: afe_ck {
				#clock-cells = <0>;
				clocks = <&audio_sel>, <&audio_ck>;
				bit-shift = <2>;
			};

			spdf_ck: spdf_ck {
				#clock-cells = <0>;
				clocks = <&apll_sel>, <&audio_ck>;
				bit-shift = <21>;
			};
		};
	};
```

## Documentation/devicetree/bindings/drm/bridge/it6151.txt
```
it6151 bridge bindings

Required properties:
	- compatible: "ite,it6151"
	- reg: i2c address of the bridge's dp tx.
	- rxreg: i2c address of the bridge's mipi rx.
	- reset-gpio: OF device-tree gpio specification

Example:
	ite6151: edp-bridge@5c {
		compatible = "ite,it6151";
		reg = <0x5c>;
		rxreg = <0x6c>;
		reset-gpio = <&pio 94 GPIO_ACTIVE_HIGH>;
	};
```

## Documentation/devicetree/bindings/iommu/mediatek,iommu.txt
```
/******************************************************/
/*    Mediatek IOMMU Hardware block diagram           */
/******************************************************/
              EMI (External Memory Interface)
               |
              m4u (Multimedia Memory Management Unit)
               |
              smi (Smart Multimedia Interface)
               |
        +---------------+-------
        |               |
        |               |
    vdec larb       disp larb      ... SoCs have different local arbiter(larb).
        |               |
        |               |
   +----+----+    +-----+-----+
   |    |    |    |     |     |    ...
   |    |    |    |     |     |    ...
   |    |    |    |     |     |    ...
  MC   PP   VLD  OVL0 RDMA0 WDMA0  ... There are different ports in each larb.

Required properties:
- compatible : must be "mediatek,mt8173-iommu"
- reg : m4u register base
- interrupts : must contain the interrupts from each internal translation unit
- clocks : must contain one entry for each clock-name
- clock-name: m4u clock
- larb : must contain the larbes of current platform
- iommu-cells : must be 1. Specifies the client PortID as defined in
dt-binding/iommu/mt**-iommu-port.h

Example:
		iommu: mmsys_iommu@10205000 {
			compatible = "mediatek,mt8173-iommu";
			reg = <0 0x10205000 0 0x1000>;
			interrupts = <GIC_SPI 139 IRQ_TYPE_LEVEL_LOW>;
			clocks = <&infrasys INFRA_M4U>;
			clock-names = "infra_m4u";
			larb = <&larb0 &larb1 &larb2 &larb3 &larb4 &larb5>;
			#iommu-cells = <1>;
		};
```

## Documentation/devicetree/bindings/mfd/mt6397.txt
```
MediaTek MT6397 Multifunction Device Driver

MT6397 is a multifunction device with the following sub modules:
- Regulator
- RTC
- Audio codec
- GPIO
- Clock

It is interfaced to host controller using SPI interface by a proprietary hardware
called PMIC wrapper or pwrap. MT6397 MFD is a child device of pwrap.
See the following for pwarp node definitions:
Documentation/devicetree/bindings/soc/mediatek,mt8135-pwrap.txt

This document describes the binding for mfd device and its sub module.

Required properties:
compatible: "mediatek,mt6397"

Optional properties:
- codec: Audio codec
- pinctrl: GPIO in mt6397
- rtc: RTC
- clock: clocks in mt6397
- regulators: regulators in mt6397

Example:
	pwrap: pwrap@1000f000 {
		compatible = "mediatek,mt8135-pwrap";
		reg = <0 0x1000f000 0 0x1000>,
			<0 0x11017000 0 0x1000>;
		reg-names = "pwrap-base", "pwrap-bridge-base";
		interrupts = <GIC_SPI 128 IRQ_TYPE_LEVEL_HIGH>;
		resets = <&infrarst MT8135_INFRA_PMIC_WRAP_RST>,
				<&perirst MT8135_PERI_PWRAP_BRIDGE_SW_RST>;
		reset-names = "infra-pwrap-rst",
				"peri-pwrap-bridge-rst";
		clocks = <&pmicspi_sel>, <&clk26m>;
		clock-names = "pmicspi-sel", "pmicspi-parent";

		pmic {
			compatible = "mediatek,mt6397";

			codec: mt6397codec {
				compatible = "mediatek,mt6397-codec";
			};

			pinctrl@0x0000C000 {
				compatible = "mediatek,mt6397-pinctrl";
				reg = <0 0x0000C000 0 0x0108>;
				gpio-controller;
			};

			mt6397regulator: mt6397regulator {
				compatible = "mediatek,mt6397-regulator";

				mt6397_vpca15_reg: buck_vpca15 {
					regulator-compatible = "buck_vpca15";
					regulator-name = "vpca15";
					regulator-min-microvolt = < 850000>;
					regulator-max-microvolt = <1400000>;
					regulator-ramp-delay = <12500>;
					regulator-always-on;
				};

				mt6397_vgp4_reg: ldo_vgp4 {
					regulator-compatible = "ldo_vgp4";
					regulator-name = "vgp4";
					regulator-min-microvolt = <1200000>;
					regulator-max-microvolt = <3300000>;
					regulator-enable-ramp-delay = <218>;
				};
			};
		};
	};
```

## Documentation/devicetree/bindings/mfd/syscon.txt
```
* System Controller Registers R/W driver

System controller node represents a register region containing a set
of miscellaneous registers. The registers are not cohesive enough to
represent as any specific type of device. The typical use-case is for
some other node's driver, or platform-specific code, to acquire a
reference to the syscon node (e.g. by phandle, node path, or search
using a specific compatible value), interrogate the node (or associated
OS driver) to determine the location of the registers, and access the
registers directly.

Optionally, devices that are only controlled through single syscon
registers or bitfields can also be added as child nodes to the syscon
device node. These devices can implicitly assume their parent node
as syscon provider without referencing it explicitly via phandle.
In this case, the syscon node should have #address-cells = <1> and
#size-cells = <0> or <1> and no ranges property.

Required properties:
- compatible: Should contain "syscon".
- reg: the register region can be accessed from syscon

Examples:
gpr: iomuxc-gpr@020e0000 {
	#address-cells = <1>;
	#size-cells = <0>;
	compatible = "fsl,imx6q-iomuxc-gpr", "syscon";
	reg = <0x020e0000 0x38>;
};
```

## Documentation/devicetree/bindings/mmc/mtk-sd.txt
```
* MTK MMC controller

The MTK  MSDC can act as a MMC controller
to support MMC, SD, and SDIO types of memory cards.

This file documents differences between the core properties in mmc.txt
and the properties used by the msdc driver.

Required properties:
- compatible: Should be "mediatek,mt8173-mmc","mediatek,mt8135-mmc".
- interrupts: Should contain MSDC interrupt number
- core-power-supply: power to the Core
- clocks: MSDC source clock
- clock-names: "source"
- pinctrl-names: should be "default", "state_uhs"
- pinctrl-0: should contain default/high speed pin ctrl
- pinctrl-1: should contain uhs mode pin ctrl

Optional properties:
- io-power-supply: power to the IO(for SD/SDIO)

Examples:
mmc0: mmc@11230000 {
	compatible = "mediatek,mt8173-mmc","mediatek,mt8135-mmc";
	reg = <0 0x11230000 0 0x108>;
	interrupts = <GIC_SPI 39 IRQ_TYPE_LEVEL_LOW>;
	core-power-supply = <&mt6397_vemc_3v3_reg>;
	clocks = <&pericfg PERI_MSDC20_1_CK>;
	clock-names = "source";
	pinctrl-names = "default", "state_uhs";
	pinctrl-0 = <&mmc0_pins_default>;
	pinctrl-1 = <&mmc0_pins_uhs>;
};
```

## Documentation/devicetree/bindings/pinctrl/pinctrl-mt65xx.txt
```
* Mediatek MT65XX Pin Controller

The Mediatek's Pin controller is used to control GPIO pins.

Required properties:
- compatible: value should be either of the following.
    (a) "mediatek,mt8135-pinctrl", compatible with mt8135 pinctrl.
- reg: Should contain the register physical address and length for the
  pin controller.

Please refer to pinctrl-bindings.txt in this directory for details of the
common pinctrl bindings used by client devices.

A pinctrl node should contain at least one subnodes representing the
pinctrl groups available on the machine. Each subnode will list the
pins it needs, and how they should be configured, with regard to muxer
configuration and pullups. If one of these options is
not set, its actual value will be unspecified.

Required subnode-properties:

- mediatek,pins: List of strings containing the pin name.
- mediatek,function: Function to mux the pins listed above to.

Optional subnode-properties:
- mediatek,pull: Integer.
    0: No resistor
    1: Pull-up resistor
    2: Pull-down resistor

Examples:

pinctrl@01c20800 {
	compatible = "mediatek,mt8135-pinctrl";
	reg = <0x01c20800 0x400>;

	i2c0_pins_a: i2c0@0 {
		mediatek,pins = "W9", "W11";
		mediatek,function = <1>;
		mediatek,pull = <0>;
	};

	i2c1_pins_a: i2c1@0 {
		mediatek,pins = "F2", "F3";
		mediatek,function = <1>;
		mediatek,pull = <0>;
	};

	i2c2_pins_a: i2c2@0 {
		mediatek,pins = "G2", "F4";
		mediatek,function = <1>;
		mediatek,pull = <0>;
	};

	i2c3_pins_a: i2c3@0 {
		mediatek,pins = "L19", "L20";
		mediatek,function = <1>;
		mediatek,pull = <0>;
	};

	uart2_pins_a: uart2@0 {
		mediatek,pins = "R18", "R17";
		mediatek,function = <1>;
		mediatek,pull = <0>;
	};

	uart3_pins_a: uart3@0 {
		mediatek,pins = "C3", "B2";
		mediatek,function = <1>;
		mediatek,pull = <0>;
	};
	...

};
```
